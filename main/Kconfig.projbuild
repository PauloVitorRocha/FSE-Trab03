## main/Kconfig.projbuild
```kconfig
menu "Configuração do Wifi Configuration"

    config ESP_WIFI_SSID
        string "WiFi SSID"
        default "ssid"
        help
            Nome da rede Wifi.

    config ESP_WIFI_PASSWORD
        string "Senha do Wifi"
        default "minha_senha"
        help
            Senha do WiFi (WPA or WPA2).

    config ESP_MAXIMUM_RETRY
        int "Número máximo de tentativas de conexão"
        default 5
        help
            Configure o valor máximo de tentativas de conexão.
endmenu

menu "Configuração API KEYS Configuration"

    config IP_STACK_ACCESS_KEY
        string "chave de acesso da api ipstack"
        default "minha_chave"
        help
            É a chave de acesso da api do IP STACK, acesse ela pelo link https://ipstack.com/quickstart

    config OPEN_WEATHER_MAP_ACCESS_KEY
        string "chave de acessp da api openweathermap"
        default "minha_chave"
        help
            É a chave de acesso da api do openweathermap, acesse ela pelo link https://home.openweathermap.org/api_keys

endmenu
```
